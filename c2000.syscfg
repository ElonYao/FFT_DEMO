/**
 * @cliArgs --board "/boards/LAUNCHXL_F280039C" --device "F28003x" --part "F28003x_100PZ" --package "100PZ" --context "system" --product "C2000WARE@5.05.00.00"
 * @versions {"tool":"1.24.0+4150"}
 */

/**
 * Import the modules used in this configuration.
 */
const FREERTOS  = scripting.addModule("/kernel/freertos_tool/FREERTOS", {}, false);
const FREERTOS1 = FREERTOS.addInstance();
const logger    = scripting.addModule("/libraries/control/dcl/logger.js", {}, false);
const logger1   = logger.addInstance();

/**
 * Write custom configuration values to the imported modules.
 */
FREERTOS1.$name                         = "RTOS0";
FREERTOS1.START_SCHEDULER               = false;
FREERTOS1.CPU_CLOCK_HZ                  = 120000000;
FREERTOS1.MAX_PRIORITIES                = 5;
FREERTOS1.MINIMAL_STACK_SIZE            = 256;
FREERTOS1.IDLE_SHOULD_YIELD             = true;
FREERTOS1.USE_MUTEXES                   = true;
FREERTOS1.USE_COUNTING_SEMAPHORES       = true;
FREERTOS1.USE_QUEUE_SETS                = true;
FREERTOS1.ENABLE_BACKWARD_COMPATIBILITY = true;
FREERTOS1.TOTAL_HEAP_SIZE               = 2048;
FREERTOS1.CHECK_FOR_STACK_OVERFLOW      = 2;
FREERTOS1.USE_MALLOC_FAILED_HOOK        = true;
FREERTOS1.vTaskDelete                   = true;

logger1.$name   = "myLOGGER0";
logger1.fillEn  = true;
logger1.logSize = 256;
